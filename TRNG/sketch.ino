#include <Key.h>
#include <Keypad.h>
#include <SPI.h>
#include <Wire.h>
#include <Adafruit_Fingerprint.h>
#include <Adafruit_GFX.h>
#include <Adafruit_SSD1306.h>
#include <U8g2lib.h>

#define SCREEN_WIDTH 128 // OLED display width, in pixels
#define SCREEN_HEIGHT 64 // OLED display height, in pixels
#define fingerSerial Serial1

const byte KEYROWS = 4;
const byte KEYCOLS = 4;

char keypadArray[KEYROWS][KEYCOLS] = {
  {'1', '2', '3', 'A'},
  {'4', '5', '6', 'B'},
  {'7', '8', '9', 'C'},
  {'*', '0', '#', 'D'}
};

static char cross[] = {
  0x07, 0x00, 0x00, 0x00, 0x00, 0x00, 0x00, 0x00, 0x00, 0x00, 0x00, 0x00, 
  0x00, 0x00, 0x00, 0xE0, 0x1C, 0x00, 0x00, 0x00, 0x00, 0x00, 0x00, 0x00, 
  0x00, 0x00, 0x00, 0x00, 0x00, 0x00, 0x00, 0x30, 0x70, 0x00, 0x00, 0x00, 
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  0x00, 0x00, 0x00, 0xE0, };

byte rowPins[KEYROWS] = {36, 34, 32, 30}; 
byte colPins[KEYCOLS] = {28, 26, 24, 22};

const int buzzerPin = 8;

//Use MEGA Communcation pins
Adafruit_Fingerprint finger = Adafruit_Fingerprint(&fingerSerial);

//Create keypad
Keypad keypad = Keypad(makeKeymap(keypadArray), rowPins, colPins, KEYROWS, KEYCOLS); 

//Create displays
U8G2_SSD1306_128X64_NONAME_F_4W_SW_SPI DIS_LEFT(U8G2_R0, /* clock=*/ 3, /* data=*/ 4, /* cs=*/ 7, /* dc=*/ 6, /* reset=*/ 5);
U8G2_SSD1306_128X64_NONAME_F_4W_SW_SPI DIS_RIGHT(U8G2_R0, /* clock=*/ 9, /* data=*/ 10, /* cs=*/ 13, /* dc=*/ 12, /* reset=*/ 11);

void keypadInput(KeypadEvent key){
   switch (keypad.getState()){
    case PRESSED:
      analogWrite(buzzerPin, 350);
      Serial.println(key);
    break;
    case RELEASED:
      //Serial.println(key);
    break;
    case HOLD:
      analogWrite(buzzerPin, 350);
      Serial.println(key);
    break;
  }
}

int matchPrint(){
  uint8_t f = finger.getImage();
  if (f != FINGERPRINT_OK)  {
    return -1;
  }

  f = finger.image2Tz();
  if (f != FINGERPRINT_OK)  return -1;

  f = finger.fingerSearch();
  
  if (f != FINGERPRINT_OK){
    if (f == FINGERPRINT_NOTFOUND){
      return -9999;    
    }
    return -1;
  }
  //We found the finger print!
  return finger.fingerID;
}

void setup() {
  Serial.begin(9600);
  
  //Begin Serial with finger sensor
  finger.begin(57600);
  delay(5);
  if (finger.verifyPassword()) {
    Serial.println("Found fingerprint sensor!");
  } else {
    Serial.println("Did not find fingerprint sensor :(");
    while (1) { delay(1); }
  }

  finger.getParameters();
  finger.getTemplateCount();

  DIS_RIGHT.begin();
  DIS_RIGHT.clearBuffer();
  DIS_RIGHT.setFont(u8g2_font_pressstart2p_8f);  // choose a suitable font
  DIS_RIGHT.drawXBM(0, 0, 128, 64, cross);
  DIS_RIGHT.sendBuffer();         // transfer internal memory to the display

  DIS_LEFT.begin();
  DIS_LEFT.clearBuffer();
  DIS_LEFT.setFont(u8g2_font_pressstart2p_8f);  // choose a suitable font
  DIS_LEFT.drawStr(32, 32,"STANDBY");  // write something to the internal memory
  DIS_LEFT.sendBuffer();         // transfer internal memory to the display
  
  keypad.addEventListener(keypadInput); //add an event listener for this keypad
  
  pinMode(buzzerPin, OUTPUT);  // sets the pin as output

  Serial.println("Ready.");
}

void loop() {
  // put your main code here, to run repeatedly:
  int f = matchPrint();
  if (f >= 0){
  Serial.println("GOT RET: ");
  Serial.println(f);
    analogWrite(buzzerPin, 150);
    delay(150);
    analogWrite(buzzerPin, 350);
    delay(150);
    analogWrite(buzzerPin, 550);
    delay(150);
    analogWrite(buzzerPin, 650);
    delay(150);
    analogWrite(buzzerPin, 1023);
  }
  else if (f == -9999){
  Serial.println("GOT RET: ");
  Serial.println(f);
    analogWrite(buzzerPin, 1023);
    delay(150);
    analogWrite(buzzerPin, 150);
  }
  char key = keypad.getKey();

  if (key) {
    Serial.println(key);
  }
  delay(50);

  analogWrite(buzzerPin, 0);

  
}
